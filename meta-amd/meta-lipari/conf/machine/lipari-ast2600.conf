## meta-amd/meta-lipari/conf/machine/lipari-ast2600.conf
```bitbake
#KERNEL_DEVICETREE = "aspeed-ast2600-evb.dtb"
KERNEL_DEVICETREE = "aspeed-ast2600-lipari.dtb"
#UBOOT_MACHINE = "ast2600_openbmc_defconfig"
UBOOT_MACHINE = "ast2600_openbmc_spl_defconfig"
#UBOOT_DEVICETREE = "ast2600a1-evb"
UBOOT_DEVICETREE = "ast2600-evb"
SPL_BINARY = "spl/u-boot-spl.bin"

SOCSEC_SIGN_ENABLE = "0"

require conf/machine/include/ast2600.inc

SERIAL_CONSOLES = "115200;ttyS4"
# AST2600 EVB has 64MB SPI flash
FLASH_SIZE = "65536"

MACHINEOVERRIDES =. "lipari-ast2600:"
```
